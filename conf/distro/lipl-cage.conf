## conf/distro/lipl-cage.conf
```bitbake
require conf/distro/poky.conf
require conf/distro/include/init-manager-systemd.inc

DISTRO = "lipl-cage"
DISTRO_NAME = "Lipl Cage Kiosk Distribution"
DISTRO_VERSION = "1.0"
DISTRO_CODENAME = "lipl"

INIT_MANAGER = "systemd"

DISTRO_FEATURES:append = " bluetooth dbus opengl pam wayland weston"
DISTRO_FEATURES:remove = " \
    alsa \
    ipv4 \
    ipv6 \
    wifi \
    3g \
    nfc \
    gobject-introspection-data \
    pulseaudio \
    x11 \
    ptest \
"
```
